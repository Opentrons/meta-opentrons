## conf/distro/opentrons.conf
```bitbake
DISTRO = "opentrons"
DISTRO_NAME = "Opentrons (Opentrons OT3 Distro)"
DISTRO_VERSION = "0.0.1"
DISTRO_CODENAME = "ot3"
require ../meta-toradex-distro/conf/distro/tdx-xwayland.conf
DISTRO_FEATURES_append = " systemd"
DISTRO_FEATURES_BACKFILL_CONSIDERED += "sysvinit"
VIRTUAL-RUNTIME_init_manager = "systemd"
VIRTUAL-RUNTIME_initscripts = "systemd-compat-units"
PREFERRED_VERSION_python3-pyserial ?= "3.5"
```

## wic/ot3.wks
```
# short-description: Create SD card image with a boot partition
# long-description:
# Create an image that can be written onto a SD card using dd for use
# with i.MX SoC family
# It uses u-boot + other binaries gathered together on imx-boot file
#
# The disk layout used is:
#  - ---------- -------------- ------------- -------------- --------------   
# | | imx-boot |     boot     |    rootfs   |    rootfs2   |    var       |  
#  - ---------- -------------- ------------- -------------- --------------   
# ^ ^          ^              ^              ^              ^
# | |          |              |              |              |
# 0 |        8MiB          72MiB          72MiB + rootfs    72MIB + rootfs
#   ${IMX_BOOT_SEEK} 32 or 33kiB, see reference manual
#
#
part u-boot --source rawcopy --sourceparams="file=imx-boot" --ondisk mmcblk --no-table --align 33 
part /boot --source bootimg-partition --ondisk mmcblk --fstype=vfat --label boot --active --align 8192 --size 64
part / --source rootfs --ondisk mmcblk --fstype=ext4 --label root --align 8192 --size 128 
part / --source rootfs --ondisk mmcblk --fstype=ext4 --label root2 --align 8192 --size 128 
part /var --source rootfs --ondisk mmcblk --fstype=ext4 --label data --align 8129 --size 32
bootloader --ptable msdos
```
